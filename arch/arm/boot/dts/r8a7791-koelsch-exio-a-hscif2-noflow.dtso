/*
 * Device Tree Overlay for HSCIF2 on r8a7791/Koelsch EXIO Connector A, with
 * RTS/CTS hardware flow control disabled
 *
 * Copyright (C) 2016 Glider bvba
 *
 * This file is licensed under the terms of the GNU General Public License
 * version 2.  This program is licensed "as is" without any warranty of any
 * kind, whether express or implied.
 *
 * Pinout:
 *   - TXD = EXIO Connector A pin 62
 *   - RXD = EXIO Connector A pin 66
 */

/dts-v1/;
/plugin/;

&pfc {
	hscif2_pins: hscif2 {
		groups = "hscif2_data_b";
		function = "hscif2";
	};
};

&hscif2 {
	pinctrl-0 = <&hscif2_pins>;
	pinctrl-names = "default";

	status = "okay";
};
