/*
 * Device Tree Overlay for HSCIF1 on r8a7791/Koelsch EXIO Connector A
 *
 * Copyright (C) 2015 Glider bvba
 *
 * This file is licensed under the terms of the GNU General Public License
 * version 2.  This program is licensed "as is" without any warranty of any
 * kind, whether express or implied.
 *
 * Pinout:
 *   - TXD = EXIO Connector A pin 53
 *   - RXD = EXIO Connector A pin 72
 */

/dts-v1/;
/plugin/;

&pfc {
	hscif1_pins: hscif1 {
		groups = "hscif1_data_b";
		function = "hscif1";
	};
};

&hscif1 {
	pinctrl-0 = <&hscif1_pins>;
	pinctrl-names = "default";

	status = "okay";
};
