/*
 * Device Tree Overlay for SCIFB0 on r8a7791/Koelsch EXIO Connector A, with
 * RTS/CTS hardware flow control disabled
 *
 * Copyright (C) 2016 Glider bvba
 *
 * This file is licensed under the terms of the GNU General Public License
 * version 2.  This program is licensed "as is" without any warranty of any
 * kind, whether express or implied.
 *
 * Pinout:
 *   - TXD = EXIO Connector A pin 60
 *   - RXD = EXIO Connector A pin 66
 */

/dts-v1/;
/plugin/;

&pfc {
	scifb0_pins: scifb0 {
		groups = "scifb0_data_b";
		function = "scifb0";
	};
};

&scifb0 {
	pinctrl-0 = <&scifb0_pins>;
	pinctrl-names = "default";

	status = "okay";
};
